## configs/dnuma_defconfig
```kconfig
BR2_x86_core2=y
BR2_DL_DIR="$(HOME)/src"
BR2_CCACHE=y
BR2_BINUTILS_VERSION_2_22=y
BR2_GCC_VERSION_4_7_X=y
BR2_TOOLCHAIN_BUILDROOT_LARGEFILE=y
BR2_ROOTFS_POST_BUILD_SCRIPT="board/dnuma/pre-image.sh"
BR2_PACKAGE_BUSYBOX_CONFIG="board/dnuma/busybox.config"
BR2_PACKAGE_DNUMA=y
BR2_PACKAGE_INOTIFY_TOOLS=y
BR2_TARGET_ROOTFS_EXT2=y
# BR2_TARGET_ROOTFS_TAR is not set
BR2_LINUX_KERNEL=y
BR2_LINUX_KERNEL_CUSTOM_GIT=y
BR2_LINUX_KERNEL_CUSTOM_GIT_REPO_URL="$(HOME)/g/linux"
BR2_LINUX_KERNEL_USE_CUSTOM_CONFIG=y
BR2_LINUX_KERNEL_CUSTOM_CONFIG_FILE="board/dnuma/linux-3.6.config"
```

## configs/dnuma_qemu_x86_defconfig
```kconfig
BR2_x86_i686=y
BR2_DL_DIR="$(HOME)/src"
BR2_CCACHE=y
BR2_BINUTILS_VERSION_2_22=y
BR2_GCC_VERSION_4_7_X=y
BR2_PACKAGE_GDB=y
BR2_PACKAGE_GDB_SERVER=y
BR2_PACKAGE_GDB_HOST=y
BR2_ENABLE_LOCALE_PURGE=y
BR2_ENABLE_LOCALE_WHITELIST="C"
BR2_TOOLCHAIN_BUILDROOT_LARGEFILE=y
BR2_TOOLCHAIN_BUILDROOT_WCHAR=y
BR2_ROOTFS_POST_BUILD_SCRIPT="board/dnuma/pre-image.sh"
BR2_PACKAGE_BUSYBOX_CONFIG="board/dnuma/busybox.config"
BR2_PACKAGE_DNUMA=y
BR2_TARGET_ROOTFS_EXT2=y
# BR2_TARGET_ROOTFS_TAR is not set
BR2_LINUX_KERNEL=y
BR2_LINUX_KERNEL_CUSTOM_GIT=y
BR2_LINUX_KERNEL_CUSTOM_GIT_REPO_URL="$(HOME)/g/linux"
BR2_LINUX_KERNEL_USE_CUSTOM_CONFIG=y
BR2_LINUX_KERNEL_CUSTOM_CONFIG_FILE="board/dnuma/linux-3.6-x86-qemu.conf"
```

## configs/tinia_defconfig
```kconfig
BR2_DL_DIR="$(HOME)/src"
BR2_BINUTILS_VERSION_2_22=y
BR2_GCC_VERSION_4_7_X=y
BR2_PACKAGE_BUSYBOX_CONFIG="board/tinia/busybox.config"
BR2_PACKAGE_TINIA=y
BR2_TARGET_ROOTFS_EXT2=y
BR2_TARGET_ROOTFS_INITRAMFS=y
BR2_LINUX_KERNEL=y
BR2_LINUX_KERNEL_USE_CUSTOM_CONFIG=y
BR2_LINUX_KERNEL_CUSTOM_CONFIG_FILE="board/tinia/linux-3.6.config"
```

## package/cryptsetup/Config.in
```kconfig
config BR2_PACKAGE_CRYPTSETUP
	bool "cryptsetup"
	depends on BR2_PACKAGE_LVM2 # we need LVM2, which needs BR2_LARGEFILE
	depends on BR2_PACKAGE_UTIL_LINUX_LIBUUID
	help
	  Sets up cryptographic volumes using dm-crypt

	  http://code.google.com/p/cryptsetup/

comment "cryptsetup requires PACKAGE_LVM2 && PACKAGE_UTIL_LINUX_LIBUUID"
	depends on !(BR2_PACKAGE_LVM2 && BR2_PAKAGE_UTIL_LINUX_LIBUUID)
```

## package/dnuma/Config.in
```kconfig
config BR2_PACKAGE_DNUMA
	bool "dynamic-numa-test"
	help
		Tester for dynamic numa support.
```

## package/elfutils/Config.in
```kconfig
config BR2_PACKAGE_ELFUTILS
	bool "elfutils"
	help
		Elfutils is a collection of utilities, including eu-ld (a
		linker), eu-nm (for listing symbols from object files), eu-size
		(for listing the section sizes of an object or archive file),
		eu-strip (for discarding symbols), eu-readelf (to see the raw
		ELF file structures), and eu-elflint (to check for well-formed
		ELF files). 
```

## package/perf/Config.in
```kconfig
config BR2_PACKAGE_PERF
	bool "perf"
	select BR2_PACKAGE_ELFUTILS
	help
		Linux profiling with performance counters. Command line tool.
```

## package/tinia/Config.in
```kconfig
config BR2_PACKAGE_TINIA
	bool "tinia (early init)"
	help
		An init for initramfs
```
